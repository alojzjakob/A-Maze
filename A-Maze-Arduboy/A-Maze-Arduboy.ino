/* A-Maze
 by Alojz Jakob <http://jakobdesign.com>

 ********** TAMAGUINO ***********
 * Maze game for Arduino *
 ********************************
 
*/

#include <Arduboy2.h>
#include <ArduboyPlaytune.h>

// make an instance of arduboy used for many functions
Arduboy2 arduboy;


ArduboyPlaytune tunes(arduboy.audio.enabled);


 // 'title', 128x64px
const unsigned char title1 [] PROGMEM = {
0x00, 0x00, 0x00, 0x00, 0x00, 0x00, 0x00, 0x00, 0x00, 0x00, 0x00, 0x00,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 0x00, 
0x00, 0x00, 0x00, 0x00, 0x00, 0x00, 0x00, 0x00, 0x00, 0x00, 0xc0, 0x20,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 0x00, 
0x00, 0x00, 0x00, 0x00, 0x00, 0x00, 0x00, 0x80, 0x7c, 0x03, 0x24, 0x01,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 0x00, 
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0x00, 0x00, 0x00, 0x00, 0x00, 0x00, 0x00, 0x00, 0x00, 0x00, 0x00, 0x00,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 0x00, 
};
 // 'title2', 128x64px
const unsigned char title2 [] PROGMEM = {
0x00, 0x00, 0x00, 0x00, 0x00, 0x00, 0x00, 0x00, 0x00, 0x00, 0x00, 0x00,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 0x00, 
0x00, 0x00, 0x00, 0x00, 0x00, 0x00, 0x00, 0x00, 0x00, 0x00, 0x80, 0x00,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 0x00, 
0x00, 0x00, 0x00, 0x00, 0x00, 0x00, 0x00, 0x00, 0x28, 0x01, 0x20, 0x01,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 0x00, 
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0x00, 0x00, 0x00, 0x00, 0x00, 0x00, 0x00, 0x00, 0x00, 0x00, 0x00, 0x00,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 0x00, 
};

 // 'title3', 128x64px
const unsigned char title3 [] PROGMEM = {
  0x00, 0x00, 0x00, 0x00, 0x00, 0x00, 0x00, 0x00, 0x00, 0x00, 0x00, 0x00,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 0x00, 
0x00, 0x00, 0x00, 0x00, 0x00, 0x00, 0x00, 0x00, 0x00, 0x00, 0x00, 0x00,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 0x00, 
0x00, 0x00, 0x00, 0x00, 0x00, 0x00, 0x00, 0x00, 0x20, 0x00, 0x20, 0x01,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 0x00, 
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0x00, 0x00, 0x00, 0x00, 0x00, 0x00, 0x00, 0x00, 0x00, 0x00, 0x00, 0x00,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 0x00, 
};

 // 'title4', 128x64px
const unsigned char title4 [] PROGMEM = {
0x00, 0x00, 0x00, 0x00, 0x00, 0x00, 0x00, 0x00, 0x00, 0x00, 0x00, 0x00,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 0x00, 
0x00, 0x00, 0x00, 0x00, 0x00, 0x00, 0x00, 0x00, 0x00, 0x00, 0x00, 0x00,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 0x00, 
0x00, 0x00, 0x00, 0x00, 0x00, 0x00, 0x00, 0x00, 0x20, 0x00, 0x00, 0x01,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 0x00, 
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0x00, 0x00, 0x00, 0x00, 0x00, 0x00, 0x00, 0x00, 0x00, 0x00, 0x00, 0x00,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 0x00, 
};

const unsigned char brick [] PROGMEM = {
  // 'brick, 4x4px
  0x0f, 0x0d, 0x09, 0x0f,
};

const unsigned char checker [] PROGMEM = {
  // 'checker, 4x4px
  0x0a, 0x05, 0x0a, 0x05, 
};

#define DELAYMULTIPLIER  0

#define MAZEHEIGHT  32
#define MAZEWIDTH  15

uint16_t  Maze[] = {
  0b1101111111111111,
  0b1100000000000001,
  0b1101010101010101,
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  0b1111111111111101,
  0b0000000000000000
};

uint8_t geni, genj, genk, genval, genmod;
int8_t  genx, geny;


int posx=0, posy=2; // Where you are in the Maze

int illuminatedRow=0;
int blinkPlayer=1;
int wallPhase=1;

int level=1;





void setup() {
  arduboy.begin();
  Serial.begin(9600);
  arduboy.initRandomSeed();
// audio setup
  tunes.initChannel(PIN_SPEAKER_1);
#ifndef AB_DEVKIT
  // if not a DevKit
  tunes.initChannel(PIN_SPEAKER_2);
#else
  // if it's a DevKit
  tunes.initChannel(PIN_SPEAKER_1); // use the same pin for both channels
  tunes.toneMutesScore(true);       // mute the score when a tone is sounding
#endif
  //randomSeed(analogRead(A5));
  delay(random(2,2000));
  arduboy.clear();

  // splash
  ////arduboy.setTextColor(WHITE);
  //arduboy.println(F("jakobdesign presents")); 
  //arduboy.print(F(" generating maze...")); 
  arduboy.drawBitmap(0, 0, title4 , 128, 64, WHITE);
  arduboy.display();
  tunes.tone(1500,5);
  delay(100);
  arduboy.clear();
  arduboy.drawBitmap(0, 0, title3 , 128, 64, WHITE);
  arduboy.display();
  tunes.tone(1500,5);
  delay(100);
  arduboy.clear();
  arduboy.drawBitmap(0, 0, title2 , 128, 64, WHITE);
  arduboy.display();
  tunes.tone(1500,5);
  delay(100);
  arduboy.clear();
  arduboy.drawBitmap(0, 0, title1 , 128, 64, WHITE);
  arduboy.display();
  tunes.tone(1500,5);
  delay(3000);
  arduboy.clear();
  arduboy.drawBitmap(0, 0, title2 , 128, 64, WHITE);
  arduboy.display();
  tunes.tone(1500,5);
  delay(100);
  arduboy.clear();
  arduboy.drawBitmap(0, 0, title3 , 128, 64, WHITE);
  arduboy.display();
  tunes.tone(1500,5);
  delay(100);
  arduboy.clear();
  arduboy.drawBitmap(0, 0, title4 , 128, 64, WHITE);
  arduboy.display();
  tunes.tone(1500,5);
  delay(100);
  arduboy.clear();
  //arduboy.drawBitmap(15, 24, splash1 , 48, 26, WHITE);
  //arduboy.drawBitmap(48, 24, splash2 , 80, 40, WHITE);
  
  
  //splash tone

  //delay(200);
  //tunes.tone(1000,200);
  //delay(400);
  //tunes.tone(700,200);
  //delay(200);
  //tunes.tone(1100,200);

  
  // end splash


  generateMaze();


  //delay(2000);

  //for(int i=0;i<MAZEHEIGHT;i++){
  //  Serial.println(Maze[i],BIN);
  //}
  
  //drawMazeSerial();
  
  
  arduboy.clear();
  
}



void loop() {
  
  
  arduboy.pollButtons();
  arduboy.clear();

 
  /* ------- BUTTON PRESS ACTIONS ------- */
  bool wall;
  
  
  /* ------- BUTTON 1 - LEFT ------- */
  if(arduboy.pressed(LEFT_BUTTON)){
    //generateMaze();
    if(posx-1>=0){
      wall=readPixel(posx-1,posy);
      if(!wall){
        --posx;
        tunes.tone(1600,5);
      }else{
        tunes.tone(100,50);  
      }
    }else{
      tunes.tone(100,50);
    }
    delay(20);
  }
  /* ------- BUTTON 2 - RIGHT ------- */
  if(arduboy.pressed(RIGHT_BUTTON)){
    if(posx+1<=MAZEHEIGHT){
      wall=readPixel(posx+1,posy);
      if(!wall){
        ++posx;
        tunes.tone(1600,5);
      }else{
        tunes.tone(100,50);  
      }
    }else{
      tunes.tone(100,50);
    }
    delay(20);
  }
  /* ------- BUTTON 3 - UP ------- */
  if(arduboy.pressed(UP_BUTTON)){
    if(posy-1>=2){
      wall=readPixel(posx,posy-1);
      if(!wall){
        --posy;
        tunes.tone(1600,5);
      }else{
        tunes.tone(100,50);  
      }
    }else{
      tunes.tone(100,50);
    }
    delay(20);
  }
  /* ------- BUTTON 4 - DOWN ------- */
  if(arduboy.pressed(DOWN_BUTTON)){
    if(posy+1<=MAZEWIDTH){
      wall=readPixel(posx,posy+1);
      if(!wall){
        ++posy;
        tunes.tone(1600,5);
      }else{
        tunes.tone(100,50);  
      }
    }else{
      tunes.tone(100,50);
    }
    delay(20);
  }
//Unused Button stuff
  /*if(arduboy.pressed(A_BUTTON)){
    arduboy.fillCircle(20,30,5,WHITE);
  }
  if(arduboy.pressed(B_BUTTON)){
    arduboy.fillCircle(50,30,5,WHITE);
  }
  if(arduboy.pressed(A_BUTTON |B_BUTTON)){
    arduboy.fillCircle(80,30,5,WHITE);
  }
  */

  
  arduboy.setCursor(0,0);

  if(posx==MAZEHEIGHT){
    posx=0;
    posy=2;
    displayLevelSplash();
    level++;
    illuminatedRow=0;
    blinkPlayer=1;
    wallPhase=1;
  }else{
    drawMaze();
  }
  
  
  arduboy.display();

  delay(10*DELAYMULTIPLIER);

}



void displayLevelSplash(){
  int levely=-8,levelnoy=-8,completey=-8, i, j;
  
  ////arduboy.setTextColor(WHITE);
  for(i=0;i<3;i++){
    for(j=0;j<50;j+=2){
      arduboy.clear();
      if(levely<20){
        levely+=2;
        tunes.tone(levely*65,5);
      }
      if(levely==20 and levelnoy<30){
        levelnoy+=2;
        tunes.tone(levelnoy*65,5);
      }
      if(levely==20 and levelnoy==30 and completey<40){
        completey+=2;
        tunes.tone(completey*65,5);
      }
      arduboy.setCursor(15,levely);
      arduboy.setTextBackground(BLACK);
      arduboy.setTextColor(WHITE);
      arduboy.print("LEVEL");
      arduboy.setCursor(45,levelnoy);
      arduboy.print(level);
      arduboy.setCursor(55,completey);
      arduboy.print("COMPLETE!");
      arduboy.display();
    }
  }
  
  delay(1000);
  
  levely=-8;
  levelnoy=-8;
  for(i=0;i<2;i++){
    for(j=0;j<50;j+=2){
      arduboy.clear();
      if(levely<20){
        levely+=2;
        tunes.tone(levely*65,5);
      }
      if(levely==20 and levelnoy<30){
        levelnoy+=2;
        tunes.tone(levelnoy*65,5);
      }
      arduboy.setCursor(15,levely);
      arduboy.print("LEVEL");
      arduboy.setCursor(45,levelnoy);
      arduboy.print(level+1);
      arduboy.display();
    }
  }
  
  delay(1500);
  
  generateMaze();
}

void drawMazeSerial(){
  uint8_t i, j;
  bool dot;
  for(i=0;i<=MAZEHEIGHT;i++){
    for(j=0;j<=MAZEWIDTH;j++){
      dot=readPixel(i,j);
      if(dot){
        Serial.print("*");
      }else{
        Serial.print(" ");
      }
    }
    Serial.println();
  }  
}


void drawMaze(){
  uint8_t i, j;
  bool wall;
  
  for(i=0;i<=MAZEHEIGHT;i++){
    for(j=0;j<=MAZEWIDTH;j++){
      wall=readPixel(i,j);
      if(wall){

        //walls
        
        if(wallPhase==1){
          if(illuminatedRow>=i){
            arduboy.drawPixel(i*4,j*4,WHITE);
            arduboy.drawPixel(i*4,j*4+2,WHITE);
            arduboy.drawPixel(i*4+1,j*4+1,WHITE);
            arduboy.drawPixel(i*4+1,j*4+3,WHITE);
            arduboy.drawPixel(i*4+2,j*4+2,WHITE);
            arduboy.drawPixel(i*4+2,j*4+4,WHITE);
            arduboy.drawPixel(i*4+3,j*4+1,WHITE);
            arduboy.drawPixel(i*4+3,j*4+3,WHITE);
          }else{
            arduboy.drawPixel(i*4+2,j*4+2,WHITE);
          }
        }else if(wallPhase==2){
          if(illuminatedRow>=i){
            arduboy.fillRect(i*4,j*4,4,4,WHITE);
          }else{
            //arduboy.drawRect(i*4,j*4,4,4,WHITE);
            arduboy.drawPixel(i*4,j*4,WHITE);
            arduboy.drawPixel(i*4,j*4+2,WHITE);
            arduboy.drawPixel(i*4+1,j*4+1,WHITE);
            arduboy.drawPixel(i*4+1,j*4+3,WHITE);
            arduboy.drawPixel(i*4+2,j*4+2,WHITE);
            arduboy.drawPixel(i*4+2,j*4+4,WHITE);
            arduboy.drawPixel(i*4+3,j*4+1,WHITE);
            arduboy.drawPixel(i*4+3,j*4+3,WHITE);
          }
        }else if(wallPhase==3){
          arduboy.fillRect(i*4,j*4,4,4,WHITE);
        }
        //arduboy.drawBitmap(i*4, j*4, brick , 4, 4, WHITE);

        if(wallPhase==3 and (i==posx or j==posy) and j!=0){
          //draw crosshair
          arduboy.drawPixel(i*4+2,j*4+2,BLACK);
        }
        
      }else{

        //not walls
        
        if(wallPhase==3 and (i==posx or j==posy) and j!=0){
          //draw crosshair
          arduboy.drawPixel(i*4+2,j*4+2,WHITE);
        }
        //arduboy.drawBitmap(i*4, j*4, checker , 4, 4, WHITE);
        /*arduboy.drawPixel(i*4,j*4,WHITE);
        arduboy.drawPixel(i*4,j*4+2,WHITE);
        arduboy.drawPixel(i*4+1,j*4+1,WHITE);
        arduboy.drawPixel(i*4+1,j*4+3,WHITE);
        arduboy.drawPixel(i*4+2,j*4+2,WHITE);
        arduboy.drawPixel(i*4+2,j*4+4,WHITE);
        arduboy.drawPixel(i*4+3,j*4+1,WHITE);
        arduboy.drawPixel(i*4+3,j*4+3,WHITE);
        */
      }
    }
  }  


    //display level
  //arduboy.fillRect(0,0,128,8,WHITE);
  if(wallPhase>1){
    arduboy.setTextBackground(WHITE);
    arduboy.setTextColor(BLACK);
    arduboy.setCursor(0,0);
    arduboy.print("level: ");
    arduboy.print(level);
  }


  //draw player
  /*
  arduboy.drawPixel(posx*4,posy*4+1,WHITE);
  arduboy.drawPixel(posx*4,posy*4+2,WHITE);
  
  arduboy.drawPixel(posx*4+1,posy*4,WHITE);
  arduboy.drawPixel(posx*4+2,posy*4,WHITE);
  
  arduboy.drawPixel(posx*4+3,posy*4+1,WHITE);
  arduboy.drawPixel(posx*4+3,posy*4+2,WHITE);
  
  arduboy.drawPixel(posx*4+1,posy*4+3,WHITE);
  arduboy.drawPixel(posx*4+2,posy*4+3,WHITE);
  */
  if(blinkPlayer==1){
    arduboy.fillCircle(posx*4+1,posy*4+1,3,WHITE);
    arduboy.fillCircle(posx*4+1,posy*4+1,1,BLACK);
  }else{
    arduboy.fillCircle(posx*4+1,posy*4+1,3,BLACK);
    arduboy.fillCircle(posx*4+1,posy*4+1,1,WHITE);
  }
  /*
  if(blinkPlayer==1){
    arduboy.drawPixel(posx*4+1,posy*4+1,WHITE);
  }
  if(blinkPlayer==2){
    arduboy.drawPixel(posx*4+2,posy*4+1,WHITE);
  }
  if(blinkPlayer==3){
    arduboy.drawPixel(posx*4+1,posy*4+2,WHITE);
  }
  if(blinkPlayer==4){
    arduboy.drawPixel(posx*4+2,posy*4+2,WHITE);
  }
  */
  blinkPlayer++;
  if(blinkPlayer>16){
    blinkPlayer=1;
  }
  
  if(illuminatedRow<MAZEHEIGHT+1){
    illuminatedRow++;
  }else{
    if(wallPhase<3){
      wallPhase++;
      if(wallPhase==2){
        illuminatedRow=0;
      }
    }
  }

  

}

bool readPixel(uint8_t i, uint8_t j){
  uint16_t Data = Maze[i];
  byte Hi = (Data & 0xFF00)>>8;
  byte Lo = Data & 0x00FF;  
  if(j>7){
    return bitRead(Lo, 7 - (j % 8));
  }else{
    //j=j-8;
    return bitRead(Hi, 7 - (j % 8));
  }
}





void generateMaze(){
  bool alternate=false;
  for (geni = 1; geni < MAZEHEIGHT-1; geni++) {
    if(!alternate){
      Maze[geni] = 0b1100000000000001;
    }else{
      Maze[geni] = 0b1101010101010101;
    }
    alternate=!alternate;
  }
  genmod = 4;
  for (geni = 2; geni < MAZEHEIGHT - 2; geni += 2) {
    for (genj = 3; genj < MAZEWIDTH - 1; genj += 2) {
      Maze[geni] |= (0x8000 >> genj);
      do{
        //Roll a stick
        random();
        //genval = (uint8_t)(analogRead(A0) & 0x00FF) % genmod;
        genval = (uint8_t)(random(10000) & 0x00FF) % genmod;
        //val = analogRead(A0) % mod;
        genx = 0, geny = 0;
        if (genval == 0)geny = 1;
        if (genval == 1)genx = -1;
        if (genval == 2)genx = 1;
        if (genval == 3)geny = -1;
      }while ((Maze[geni + geny] & (0x8000 >> (genj + genx)))); 
      Maze[geni + geny] |= (0x8000 >> (genj + genx));
    }
    genmod = 3;
  }
}
